## os_client/Kconfig
```kconfig
menu "Toob Network Client"
    # GAP-N23: Mirrored configuration for ESP-IDF. Keep symmetric with zephyr/Kconfig!

    config TOOB_NETWORK_CLIENT
        bool "Enable Toob Network Client"
        default y
        help
          Enables the Toob OTA Network Client component.

    config TOOB_SERVER_URL
        string "OTA Server URL"
        default "https://api.toob.io/v1/update"
        depends on TOOB_NETWORK_CLIENT
        help
          The base URL for the OTA update server.

    config TOOB_POLL_INTERVAL_SEC
        int "OTA Polling Interval (Seconds)"
        default 86400
        depends on TOOB_NETWORK_CLIENT
        help
          How often the daemon checks for new updates (default 24h).

endmenu
```

## os_client/zephyr/Kconfig
```kconfig
menuconfig TOOB_NETWORK_CLIENT
    bool "Toob Network Client (OTA Daemon)"
    default y
    help
      Enables the OS-agnostic Network Client for Toob-Loader OTA updates.

if TOOB_NETWORK_CLIENT

config TOOB_SERVER_URL
    string "OTA Server URL"
    default "https://api.toob.io/v1/update"
    help
      The base URL for the OTA update server.

config TOOB_POLL_INTERVAL_SEC
    int "OTA Polling Interval (Seconds)"
    default 86400
    help
      How often the daemon checks for new updates (default 24h).

config TOOB_TLS_SEC_TAG
    int "TLS Security Tag for Server CA"
    default 1
    help
      The sec_tag used by the TLS subsystem to reference the provisioned
      Server Root CA certificate. Must be provisioned via
      tls_credential_add() during boot.

endif # TOOB_NETWORK_CLIENT
```
